// SPDX-License-Identifier: BSD-3-Clause

/dts-v1/;

/ {
	model = "Qualcomm Technologies, Inc. MSM8992 P1 GLOBAL COM";
	qcom,msm-id = <0xfb 0x00 0xfc 0x00>;
	qcom,pmic-id = <0x10009 0x1000a 0x00 0x00>;
	qcom,board-id = <0x464 0x00 0x364 0x00>;

	#address-cells = <2>;
	#size-cells = <2>;

	chosen { };

	memory@0 {
		device_type = "memory";
		reg = <0 0 0 0>;
	};
};